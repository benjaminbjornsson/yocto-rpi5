## meta-benjamin/conf/layer.conf
```bitbake
# We have a conf and classes directory, add to BBPATH
BBPATH .= ":${LAYERDIR}"

# We have recipes-* directories, add to BBFILES
BBFILES += "${LAYERDIR}/recipes-*/*/*.bb \
            ${LAYERDIR}/recipes-*/*/*.bbappend"

BBFILE_COLLECTIONS += "meta-benjamin"
BBFILE_PATTERN_meta-benjamin = "^${LAYERDIR}/"
BBFILE_PRIORITY_meta-benjamin = "6"

LAYERDEPENDS_meta-benjamin = "core"
LAYERSERIES_COMPAT_meta-benjamin = "scarthgap"
```
